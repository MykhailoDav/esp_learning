#include "ssd1306.h"
#include <stdarg.h>
#include <stdio.h>
#include <string.h>

/* ---------- 8x8 font (ASCII 0–255) ---------- */
static const uint8_t font8x8[256][8] = {
    {0x00,0x00,0x00,0x00,0x00,0x00,0x00,0x00},{0x00,0x00,0x00,0x00,0x00,0x00,0x00,0x00},
    {0x00,0x00,0x00,0x00,0x00,0x00,0x00,0x00},{0x00,0x00,0x00,0x00,0x00,0x00,0x00,0x00},
    {0x00,0x00,0x00,0x00,0x00,0x00,0x00,0x00},{0x00,0x00,0x00,0x00,0x00,0x00,0x00,0x00},
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    {0x00,0x00,0x00,0x00,0x00,0x00,0x00,0x00},{0x00,0x00,0x00,0x00,0x00,0x00,0x00,0x00},
    /* 32 = space */
    {0x00,0x00,0x00,0x00,0x00,0x00,0x00,0x00},
    {0x00,0x00,0x00,0x5F,0x5F,0x00,0x00,0x00}, // !
    {0x00,0x07,0x07,0x00,0x07,0x07,0x00,0x00}, // "
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    {0x00,0x00,0x00,0x00,0x00,0x00,0x00,0x00}, // DEL
    /* 128-255: blank */
    {0},{0},{0},{0},{0},{0},{0},{0},{0},{0},{0},{0},{0},{0},{0},{0},
    {0},{0},{0},{0},{0},{0},{0},{0},{0},{0},{0},{0},{0},{0},{0},{0},
    {0},{0},{0},{0},{0},{0},{0},{0},{0},{0},{0},{0},{0},{0},{0},{0},
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    {0},{0},{0},{0},{0},{0},{0},{0},{0},{0},{0},{0},{0},{0},{0},{0},
};

/* ---------- constructor / destructor ---------- */

SSD1306::SSD1306(uint8_t addr, uint8_t width, uint8_t height)
    : _addr(addr), _width(width), _height(height),
      _pages(height / 8), _buf(nullptr), _wire(nullptr) {}

SSD1306::~SSD1306() {
    if (_buf) { free(_buf); _buf = nullptr; }
}

/* ---------- private helpers ---------- */

void SSD1306::cmd(uint8_t c) {
    _wire->beginTransmission(_addr);
    _wire->write(SSD1306_CMD);
    _wire->write(c);
    _wire->endTransmission();
}

void SSD1306::cmd2(uint8_t c, uint8_t arg) {
    _wire->beginTransmission(_addr);
    _wire->write(SSD1306_CMD);
    _wire->write(c);
    _wire->write(arg);
    _wire->endTransmission();
}

void SSD1306::cmd3(uint8_t c, uint8_t a1, uint8_t a2) {
    _wire->beginTransmission(_addr);
    _wire->write(SSD1306_CMD);
    _wire->write(c);
    _wire->write(a1);
    _wire->write(a2);
    _wire->endTransmission();
}

/* ---------- public API ---------- */

bool SSD1306::begin(TwoWire &wire) {
    _wire = &wire;

    _buf = (uint8_t *)malloc((size_t)_pages * _width);
    if (!_buf) return false;
    memset(_buf, 0, (size_t)_pages * _width);

    // Init sequence adapted from Adafruit SSD1306 / test project
    cmd(SSD1306_DISPLAYOFF);
    cmd2(SSD1306_SETDISPLAYCLOCKDIV, 0x80);
    cmd2(SSD1306_SETMULTIPLEX, _height - 1);
    cmd2(SSD1306_SETDISPLAYOFFSET, 0x00);
    cmd(SSD1306_SETSTARTLINE | 0x00);
    cmd2(SSD1306_CHARGEPUMP, 0x14);            // internal charge pump ON
    cmd2(SSD1306_MEMORYMODE, 0x00);            // horizontal addressing
    cmd(SSD1306_SEGREMAP | 0x01);              // flip H
    cmd(SSD1306_COMSCANDEC);                   // flip V
    if (_height == 32) {
        cmd2(SSD1306_SETCOMPINS, 0x02);
        cmd2(SSD1306_CONTRAST,   0x8F);
    } else {
        cmd2(SSD1306_SETCOMPINS, 0x12);
        cmd2(SSD1306_CONTRAST,   0xCF);
    }
    cmd2(SSD1306_SETPRECHARGE, 0xF1);
    cmd2(SSD1306_SETVCOMDETECT, 0x40);
    cmd(SSD1306_DISPLAYALLON_RESUME);
    cmd(SSD1306_NORMALDISPLAY);
    cmd(SSD1306_DISPLAYON);
    return true;
}

void SSD1306::clear() {
    if (_buf) memset(_buf, 0, (size_t)_pages * _width);
}

void SSD1306::display() {
    // Set full-screen addressing window
    cmd3(SSD1306_COLUMNADDR, 0, _width - 1);
    cmd3(SSD1306_PAGEADDR,   0, _pages - 1);

    // Send buffer in 16-byte chunks (safe for Arduino I2C buffer)
    uint16_t total = (uint16_t)_pages * _width;
    uint16_t i = 0;
    while (i < total) {
        uint8_t chunk = (total - i > 16) ? 16 : (uint8_t)(total - i);
        _wire->beginTransmission(_addr);
        _wire->write(SSD1306_DATA);
        for (uint8_t j = 0; j < chunk; j++) _wire->write(_buf[i + j]);
        _wire->endTransmission();
        i += chunk;
    }
}

void SSD1306::print(uint8_t x, uint8_t y, const char *text) {
    if (!_buf || !text) return;
    uint8_t page = y / 8;
    if (page >= _pages) return;

    while (*text && x < _width) {
        const uint8_t *glyph = font8x8[(uint8_t)*text];
        for (uint8_t col = 0; col < 8 && (x + col) < _width; col++) {
            _buf[(uint16_t)page * _width + x + col] = glyph[col];
        }
        x += 8;
        text++;
    }
}

void SSD1306::printf(uint8_t x, uint8_t y, const char *fmt, ...) {
    char buf[64];
    va_list ap;
    va_start(ap, fmt);
    vsnprintf(buf, sizeof(buf), fmt, ap);
    va_end(ap);
    print(x, y, buf);
}
